## tests/inference_input/testcase.yaml
```yaml
tests:
  inference.input.validation:
    platform_allow:
      - native_sim
    tags:
      - inference
      - unit
```

## tests/sensor_init/testcase.yaml
```yaml
tests:
  sensor.init.no_device:
    platform_allow:
      - native_sim
    tags:
      - sensor
      - unit
```
