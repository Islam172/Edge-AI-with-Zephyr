## CMakeLists.txt
```
cmake_minimum_required(VERSION 3.20.0)
find_package(Zephyr REQUIRED HINTS $ENV{ZEPHYR_BASE})
project(test_sensor_init)

target_sources(app PRIVATE
    src/test_sensor_init.c
    ../../src/sensor/sensor_raw.c
)

target_include_directories(app PRIVATE
    ../../src
)
```

## prj.conf
```kconfig
CONFIG_ZTEST=y
CONFIG_SENSOR=y
CONFIG_LOG=y
CONFIG_I2C=y
CONFIG_EMUL=y
CONFIG_I2C_EMUL=y
```

## src/test_sensor_init.c
```c
#include <zephyr/ztest.h>
#include <zephyr/device.h>
#include <zephyr/drivers/sensor.h>

#include "sensor/sensor_raw.h"

ZTEST_SUITE(sensor_init_suite, NULL, NULL, NULL, NULL, NULL);

/* Fehlerpfad: kein Sensor auf native_sim */
ZTEST(sensor_init_suite, test_sensor_init_no_device)
{
    int rc = SENSOR_Init();
    zassert_equal(rc, -ENODEV,
                  "Expected -ENODEV (-19), got %d", rc);
}
```
